## board/samsung/ok210/Kconfig
```kconfig
if TARGET_OK210

config SYS_BOARD
	default "ok210"

config SYS_VENDOR
	default "samsung"

config SYS_SOC
	default "s5pc1xx"

config SYS_CONFIG_NAME
	default "ok210"

endif
```

## configs/ok210_defconfig
```kconfig
CONFIG_ARM=y
CONFIG_ARCH_S5PC1XX=y
CONFIG_TARGET_OK210=y
CONFIG_DEFAULT_DEVICE_TREE="s5pc1xx-ok210"
CONFIG_HUSH_PARSER=y
CONFIG_SYS_PROMPT="OK210 # "
# CONFIG_CMD_IMLS is not set
# CONFIG_CMD_FLASH is not set
# CONFIG_CMD_SETEXPR is not set
CONFIG_CMD_CACHE=y
CONFIG_CMD_FAT=y
```
