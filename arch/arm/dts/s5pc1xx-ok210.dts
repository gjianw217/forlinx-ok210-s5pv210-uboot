/*
 * Samsung's Exynos4210-based SMDKV310 board device tree source
 *
 * Copyright (c) 2014 Google, Inc
 *
 * SPDX-License-Identifier:	GPL-2.0+
 */

/dts-v1/;

#include "skeleton.dtsi"
#include "s5pc100-pinctrl.dtsi"

/ {
	model = "Samsung SMDKC100 based on S5PC100";
	compatible = "samsung,smdkc100", "samsung,s5pc100";

	aliases {
		serial2 = "/serial@e2900800";
		console = "/serial@e2900800";
		pinctrl0 = &pinctrl0;
	};

	pinctrl0: pinctrl@e0300000 {
		compatible = "samsung,s5pc100-pinctrl";
		reg = <0xe0200000 0x1000>;
	};

	serial@e2900800 {
		compatible = "samsung,exynos4210-uart";
		reg = <0xe2900800 0x400>;
		interrupts = <0 51 0>;
		id = <2>;
	};

};
